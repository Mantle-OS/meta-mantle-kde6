## meta-kde6/conf/layer.conf
```bitbake
BBPATH .= ":${LAYERDIR}"
BBFILES += " \
    ${LAYERDIR}/recipes-*/*.bb \
    ${LAYERDIR}/recipes-*/*/*.bb \
    ${LAYERDIR}/recipes-*/*/*/*.bb \
    ${LAYERDIR}/recipes-*/*.bbappend \
    ${LAYERDIR}/recipes-*/*/*.bbappend \
    ${LAYERDIR}/recipes-*/*/*/*.bbappend \
"

LICENSE_PATH:append = "${LAYERDIR}/../licenses"

BBFILE_COLLECTIONS += "kde6-layer"
BBFILE_PATTERN_kde6-layer = "^${LAYERDIR}/"
BBFILE_PRIORITY_kde6-layer = "10"
LAYERDEPENDS_kde6-layer += " \
    openembedded-layer \
    kf6-layer \
    qt6-layer \
"
LAYERSERIES_COMPAT_kde6-layer = "scarthgap"


BBFILES_DYNAMIC += " \
    core:${LAYERDIR}/dynamic-layers/core/recipes*/*/*.bb \
    core:${LAYERDIR}/dynamic-layers/core/recipes*/*/*.bbappend \
"

KDE6_GIT ?= "git://invent.kde.org/"
KDE6_MIRROR ?= "http://download.kde.org"
KDE6_REUSE_LICENSECHECK_ENABLED ?= "0"
```

## meta-kf6/conf/layer.conf
```bitbake
BBPATH .= ":${LAYERDIR}"
BBFILES += " \
    ${LAYERDIR}/recipes-*/*.bb \
    ${LAYERDIR}/recipes-*/*/*.bb \
    ${LAYERDIR}/recipes-*/*.bbappend \
    ${LAYERDIR}/recipes-*/*/*.bbappend \
"

BBFILE_COLLECTIONS += " kf6-layer"
BBFILE_PATTERN_kf6-layer = "^${LAYERDIR}/"
BBFILE_PRIORITY_kf6-layer = "9"

LAYERSERIES_COMPAT_kf6-layer = "scarthgap"
LAYERDEPENDS_kf6-layer = " \
    core \
    yocto \
    networking-layer \
    meta-python \
    multimedia-layer \
    kde6-layer \
"

KDE6_KF6_VERSION ?= "6.17.0"
KDE6_KF6_VERSION_DIR ?= "6.17"
KDE6_KF6_MIRROR ?= "${KDE6_MIRROR}/stable/frameworks/${KDE6_KF6_VERSION_DIR}"
```

## meta-plasma6/conf/layer.conf
```bitbake
BBPATH .= ":${LAYERDIR}"
BBFILES += " \
    ${LAYERDIR}/recipes-*/*.bb \
    ${LAYERDIR}/recipes-*/*/*.bb \
    ${LAYERDIR}/recipes-*/*/*/*.bb \
    ${LAYERDIR}/recipes-*/*.bbappend \
    ${LAYERDIR}/recipes-*/*/*.bbappend \
    ${LAYERDIR}/recipes-*/*/*/*.bbappend \
"

BBFILE_COLLECTIONS += "kde6-plasma-layer"
BBFILE_PATTERN_kde6-plasma-layer = "^${LAYERDIR}/"
BBFILE_PRIORITY_kde6-plasma-layer = "10"

## FIXME 
LAYERDEPENDS_kde6-plasma-layer += " \
    openembedded-layer \
    kf6-layer \
    kde6-layer \
    qt6-layer \
"
LAYERSERIES_COMPAT_kde6-plasma-layer = "scarthgap"

KDE6_PLASMA_VERSION ?= "6.4.4"
KDE6_PLASMA_MIRROR ?= "${KDE6_MIRROR}/stable/plasma/${KDE6_PLASMA_VERSION}"
KDE6_PLASMA_WAYLAND_PROTOCOL="1.18.0"
```

## meta-rs6/conf/layer.conf
```bitbake
BBPATH .= ":${LAYERDIR}"

BBFILES += " \
    ${LAYERDIR}/recipes-*/*.bb \
    ${LAYERDIR}/recipes-*/*/*.bb \
    ${LAYERDIR}/recipes-*/*/*/*.bb \
    ${LAYERDIR}/recipes-*/*.bbappend \
    ${LAYERDIR}/recipes-*/*/*.bbappend \
    ${LAYERDIR}/recipes-*/*/*/*.bbappend \
"

BBFILE_COLLECTIONS += "kde6-rs6-layer"
BBFILE_PATTERN_kde6-rs6-layer = "^${LAYERDIR}/"
BBFILE_PRIORITY_kde6-rs6-layer = "10"

## FIXME 
LAYERDEPENDS_kde6-rs6-layer += " \
    openembedded-layer \
    kde6-layer \
    kf6-layer \
    qt6-layer \
"

LAYERSERIES_COMPAT_kde6-rs6-layer = "scarthgap"

#
KDE6_RS_VERSION ?= "25.08.0"
KDE6_RS_MIRROR ?= "${KDE6_MIRROR}/stable/release-service/${KDE6_RELEASE_SERVICE_VERSION}/srv"
```
